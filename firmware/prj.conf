## CMakeLists.txt
```
cmake_minimum_required(VERSION 3.20.0)

find_package(Zephyr REQUIRED HINTS $ENV{ZEPHYR_BASE})

project(zephyr_qemu_wasm LANGUAGES C)

target_sources(app PRIVATE src/main.c)
```

## west.yml
```
manifest:
  remotes:
    - name: zephyr
      url-base: https://github.com/zephyrproject-rtos
  projects:
    - name: zephyr
      remote: zephyr
      revision: v4.3.0
      path: zephyr
      import:
        name-allowlist:
          - cmsis
```

## prj.conf
```kconfig
# Serial and console
CONFIG_SERIAL=y
CONFIG_UART_CONSOLE=y
CONFIG_CONSOLE=y
CONFIG_UART_INTERRUPT_DRIVEN=y

# Zephyr shell subsystem
CONFIG_SHELL=y
CONFIG_SHELL_BACKEND_SERIAL=y
CONFIG_SHELL_CMDS=y
CONFIG_KERNEL_SHELL=y
CONFIG_DEVICE_SHELL=y

# Boot configuration for QEMU x86
CONFIG_MULTIBOOT=y
CONFIG_KERNEL_BIN_NAME="zephyr"

# Keep build lean

CONFIG_OUTPUT_PRINT_MEMORY_USAGE=n

# Networking: e1000 NIC (QEMU -device e1000), IPv4, DHCP, DNS.
# The browser carries the NIC's frames to relaynet, which answers DHCP
# and DNS and NATs to the internet.
CONFIG_NETWORKING=y
CONFIG_PCIE=y
CONFIG_NET_L2_ETHERNET=y
CONFIG_NET_QEMU_ETHERNET=y
CONFIG_NET_IPV4=y
CONFIG_NET_IPV6=n
CONFIG_NET_ARP=y
CONFIG_NET_UDP=y
CONFIG_NET_TCP=y
CONFIG_NET_ICMPV4_ACCEPT_BROADCAST=n
CONFIG_NET_DHCPV4=y
# Start DHCP within 2 s of boot (the minimum), not up to 10 s (guest time runs slow
# under the TCG interpreter).
CONFIG_NET_DHCPV4_INITIAL_DELAY_MAX=2
CONFIG_DNS_RESOLVER=y
CONFIG_NET_SOCKETS=y
CONFIG_NET_MGMT=y
CONFIG_NET_MGMT_EVENT=y
CONFIG_NET_SHELL=y
CONFIG_ENTROPY_GENERATOR=y
CONFIG_TEST_RANDOM_GENERATOR=y
CONFIG_NET_LOG=y
CONFIG_LOG=y
CONFIG_LOG_MODE_MINIMAL=y
CONFIG_NET_DHCPV4_LOG_LEVEL_INF=y
```

## src/main.c
```c
/*
 * SPDX-License-Identifier: Apache-2.0
 *
 * Minimal Zephyr application with shell support for QEMU x86,
 * designed to run inside QEMU compiled to WebAssembly.
 */

#include <zephyr/kernel.h>
#include <zephyr/shell/shell.h>
#include <version.h>
#include <zephyr/net/net_if.h>
#include <zephyr/net/net_mgmt.h>
#include <zephyr/net/dhcpv4.h>

/* Print the address DHCP hands out, so the console shows when the network
 * is up (the browser carries the NIC's frames to relaynet). */
static struct net_mgmt_event_callback dhcp_cb;

static void on_ipv4_addr_add(struct net_mgmt_event_callback *cb,
                             uint64_t event, struct net_if *iface)
{
    ARG_UNUSED(cb);
    if (event != NET_EVENT_IPV4_ADDR_ADD) {
        return;
    }
    struct net_if_ipv4 *ipv4 = iface->config.ip.ipv4;
    if (ipv4 == NULL) {
        return;
    }
    ARRAY_FOR_EACH(ipv4->unicast, i) {
        struct net_if_addr *a = &ipv4->unicast[i].ipv4;
        char buf[NET_IPV4_ADDR_LEN];

        if (!a->is_used || a->addr_type != NET_ADDR_DHCP) {
            continue;
        }
        printk("IPv4 address: %s\n",
               net_addr_ntop(AF_INET, &a->address.in_addr, buf, sizeof(buf)));
    }
}

static int cmd_hello(const struct shell *sh, size_t argc, char **argv)
{
    ARG_UNUSED(argc);
    ARG_UNUSED(argv);

    shell_print(sh, "Hello from Zephyr on QEMU x86 (WebAssembly)!");
    return 0;
}

static int cmd_info(const struct shell *sh, size_t argc, char **argv)
{
    ARG_UNUSED(argc);
    ARG_UNUSED(argv);

    shell_print(sh, "Board:   %s", CONFIG_BOARD);
    shell_print(sh, "Zephyr:  %s", KERNEL_VERSION_STRING);
    shell_print(sh, "Built:   " __DATE__ " " __TIME__);
    return 0;
}

SHELL_STATIC_SUBCMD_SET_CREATE(demo_cmds,
    SHELL_CMD(hello, NULL, "Print hello message", cmd_hello),
    SHELL_CMD(info, NULL, "Display system information", cmd_info),
    SHELL_SUBCMD_SET_END
);

SHELL_CMD_REGISTER(demo, &demo_cmds, "Demo commands", NULL);

int main(void)
{
    printk("*** Zephyr RTOS on QEMU x86 (WebAssembly) ***\n");
    printk("Type 'help' for available commands.\n");

    struct net_if *iface = net_if_get_default();

    if (iface != NULL) {
        net_mgmt_init_event_callback(&dhcp_cb, on_ipv4_addr_add,
                                     NET_EVENT_IPV4_ADDR_ADD);
        net_mgmt_add_event_callback(&dhcp_cb);
        net_dhcpv4_start(iface);
    }
    return 0;
}
```
